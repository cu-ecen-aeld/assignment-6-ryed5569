## meta-aesd/conf/layer.conf
```bitbake
# We have a conf and classes directory, add to BBPATH
BBPATH .= ":${LAYERDIR}"

# We have recipes-* directories, add to BBFILES
BBFILES += "${LAYERDIR}/recipes-*/*/*.bb \
            ${LAYERDIR}/recipes-*/*/*.bbappend"

BBFILE_COLLECTIONS += "meta-aesd"
BBFILE_PATTERN_meta-aesd = "^${LAYERDIR}/"
BBFILE_PRIORITY_meta-aesd = "6"

LAYERDEPENDS_meta-aesd = "core"
LAYERSERIES_COMPAT_meta-aesd = "hardknott kirkstone"

# Work around binutils gold link failure on aarch64 (2.38 kirkstone)
#PACKAGECONFIG:remove:pn-binutils = "gold"
#EXTRA_OECONF:append:pn-binutils = " --disable-gold --enable-ld=yes"

BB_NUMBER_THREADS ?= "4"
PARALLEL_MAKE ?= "-j4"
BB_LOADAVG_LIMIT ?= "6"
```
